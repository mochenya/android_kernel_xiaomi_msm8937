&mdss_mdp {
    dsi_gx_rm67198_amoled_1080p_video: qcom,mdss_dsi_gx_rm67198_amoled_1080p_video {
        qcom,cont-splash-enabled;
        qcom,esd-check-enabled;
        qcom,mdss-dsi-bl-min-level = <0x2>;
        qcom,mdss-dsi-bl-pmic-control-type = "bl_ctrl_dcs";
        qcom,mdss-dsi-bllp-eof-power-mode;
        qcom,mdss-dsi-bllp-power-mode;
        qcom,mdss-dsi-border-color = <0x0>;
        qcom,mdss-dsi-bpp = <0x18>;
        qcom,mdss-dsi-dma-trigger = "trigger_sw";
        qcom,mdss-dsi-h-back-porch = <0x24>;
        qcom,mdss-dsi-h-front-porch = <0x1a>;
        qcom,mdss-dsi-h-left-border = <0x0>;
        qcom,mdss-dsi-h-pulse-width = <0x2>;
        qcom,mdss-dsi-h-right-border = <0x0>;
        qcom,mdss-dsi-h-sync-pulse = <0x0>;
        qcom,mdss-dsi-h-sync-skew = <0x0>;
        qcom,mdss-dsi-lane-0-state;
        qcom,mdss-dsi-lane-1-state;
        qcom,mdss-dsi-lane-2-state;
        qcom,mdss-dsi-lane-3-state;
        qcom,mdss-dsi-mdp-trigger = "none";
        qcom,mdss-dsi-off-command = <0x5010000 0x10000128 0x5010000 0x40000110>;
        qcom,mdss-dsi-off-command-state = "dsi_hs_mode";
        qcom,mdss-dsi-on-command = [15 01 00 00 00 00 02 40 02 15 01 00 00 00 00 02 4b 4c 15 01 00 00 00 00 02 49 01 15 01 00 00 00 00 02 fe 40 15 01 00 00 00 00 02 c7 85 15 01 00 00 00 00 02 c8 32 15 01 00 00 00 00 02 c9 18 15 01 00 00 00 00 02 ca 09 15 01 00 00 00 00 02 cb 22 15 01 00 00 00 00 02 cc 44 15 01 00 00 00 00 02 cd 11 15 01 00 00 00 00 02 05 0f 15 01 00 00 00 00 02 06 09 15 01 00 00 00 00 02 08 0f 15 01 00 00 00 00 02 09 09 15 01 00 00 00 00 02 0a e6 15 01 00 00 00 00 02 0b 88 15 01 00 00 00 00 02 20 93 15 01 00 00 00 00 02 21 93 15 01 00 00 00 00 02 24 02 15 01 00 00 00 00 02 26 02 15 01 00 00 00 00 02 28 05 15 01 00 00 00 00 02 2a 05 15 01 00 00 00 00 02 2d 23 15 01 00 00 00 00 02 2f 23 15 01 00 00 00 00 02 30 23 15 01 00 00 00 00 02 31 23 15 01 00 00 00 00 02 37 80 15 01 00 00 00 00 02 38 50 15 01 00 00 00 00 02 39 00 15 01 00 00 00 00 02 46 1d 15 01 00 00 00 00 02 6f 00 15 01 00 00 00 00 02 74 2f 15 01 00 00 00 00 02 75 19 15 01 00 00 00 00 02 ad 00 15 01 00 00 00 00 02 fe 60 15 01 00 00 00 00 02 00 c4 15 01 00 00 00 00 02 01 00 15 01 00 00 00 00 02 02 02 15 01 00 00 00 00 02 03 00 15 01 00 00 00 00 02 04 00 15 01 00 00 00 00 02 05 07 15 01 00 00 00 00 02 06 00 15 01 00 00 00 00 02 07 83 15 01 00 00 00 00 02 09 c4 15 01 00 00 00 00 02 0a 00 15 01 00 00 00 00 02 0b 02 15 01 00 00 00 00 02 0c 00 15 01 00 00 00 00 02 0d 00 15 01 00 00 00 00 02 0e 08 15 01 00 00 00 00 02 0f 00 15 01 00 00 00 00 02 10 83 15 01 00 00 00 00 02 12 cc 15 01 00 00 00 00 02 13 0f 15 01 00 00 00 00 02 14 ff 15 01 00 00 00 00 02 15 01 15 01 00 00 00 00 02 16 00 15 01 00 00 00 00 02 17 02 15 01 00 00 00 00 02 18 00 15 01 00 00 00 00 02 19 c0 15 01 00 00 00 00 02 1b c4 15 01 00 00 00 00 02 1c 00 15 01 00 00 00 00 02 1d 02 15 01 00 00 00 00 02 1e 00 15 01 00 00 00 00 02 1f 00 15 01 00 00 00 00 02 20 07 15 01 00 00 00 00 02 21 00 15 01 00 00 00 00 02 22 83 15 01 00 00 00 00 02 24 c4 15 01 00 00 00 00 02 25 00 15 01 00 00 00 00 02 26 02 15 01 00 00 00 00 02 27 00 15 01 00 00 00 00 02 28 00 15 01 00 00 00 00 02 29 08 15 01 00 00 00 00 02 2a 00 15 01 00 00 00 00 02 2b 83 15 01 00 00 00 00 02 2f c4 15 01 00 00 00 00 02 30 00 15 01 00 00 00 00 02 31 02 15 01 00 00 00 00 02 32 00 15 01 00 00 00 00 02 33 00 15 01 00 00 00 00 02 34 07 15 01 00 00 00 00 02 35 00 15 01 00 00 00 00 02 36 83 15 01 00 00 00 00 02 38 c4 15 01 00 00 00 00 02 39 00 15 01 00 00 00 00 02 3a 02 15 01 00 00 00 00 02 3b 00 15 01 00 00 00 00 02 3d 00 15 01 00 00 00 00 02 3f 08 15 01 00 00 00 00 02 40 00 15 01 00 00 00 00 02 41 83 15 01 00 00 00 00 02 4c c4 15 01 00 00 00 00 02 4d 00 15 01 00 00 00 00 02 4e 04 15 01 00 00 00 00 02 4f 01 15 01 00 00 00 00 02 50 00 15 01 00 00 00 00 02 51 08 15 01 00 00 00 00 02 52 00 15 01 00 00 00 00 02 53 64 15 01 00 00 00 00 02 55 c4 15 01 00 00 00 00 02 56 00 15 01 00 00 00 00 02 58 04 15 01 00 00 00 00 02 59 01 15 01 00 00 00 00 02 5a 00 15 01 00 00 00 00 02 5b 06 15 01 00 00 00 00 02 5c 00 15 01 00 00 00 00 02 5d 64 15 01 00 00 00 00 02 5f ca 15 01 00 00 00 00 02 60 00 15 01 00 00 00 00 02 61 07 15 01 00 00 00 00 02 62 05 15 01 00 00 00 00 02 63 00 15 01 00 00 00 00 02 64 04 15 01 00 00 00 00 02 65 00 15 01 00 00 00 00 02 66 bb 15 01 00 00 00 00 02 67 80 15 01 00 00 00 00 02 9b 03 15 01 00 00 00 00 02 a9 10 15 01 00 00 00 00 02 aa 10 15 01 00 00 00 00 02 ab 03 15 01 00 00 00 00 02 ac 04 15 01 00 00 00 00 02 ad 00 15 01 00 00 00 00 02 ae 01 15 01 00 00 00 00 02 af 10 15 01 00 00 00 00 02 b0 10 15 01 00 00 00 00 02 b1 10 15 01 00 00 00 00 02 b2 10 15 01 00 00 00 00 02 b3 10 15 01 00 00 00 00 02 b4 10 15 01 00 00 00 00 02 b5 10 15 01 00 00 00 00 02 b6 10 15 01 00 00 00 00 02 b7 10 15 01 00 00 00 00 02 b8 10 15 01 00 00 00 00 02 b9 02 15 01 00 00 00 00 02 ba 0a 15 01 00 00 00 00 02 bb 08 15 01 00 00 00 00 02 bc 09 15 01 00 00 00 00 02 bd 06 15 01 00 00 00 00 02 be 05 15 01 00 00 00 00 02 bf 10 15 01 00 00 00 00 02 c0 10 15 01 00 00 00 00 02 c4 80 15 01 00 00 00 00 02 fe 70 15 01 00 00 00 00 02 48 05 15 01 00 00 00 00 02 52 00 15 01 00 00 00 00 02 5a ff 15 01 00 00 00 00 02 5c f6 15 01 00 00 00 00 02 5d 07 15 01 00 00 00 00 02 7d 35 15 01 00 00 00 00 02 86 07 15 01 00 00 00 00 02 a7 02 15 01 00 00 00 00 02 a9 2c 15 01 00 00 00 00 02 fe a0 15 01 00 00 00 00 02 2b 18 15 01 00 00 00 00 02 fe 90 15 01 00 00 00 00 02 26 10 15 01 00 00 00 00 02 28 20 15 01 00 00 00 00 02 2a 40 15 01 00 00 00 00 02 2d 60 15 01 00 00 00 00 02 30 70 15 01 00 00 00 00 02 32 80 15 01 00 00 00 00 02 34 90 15 01 00 00 00 00 02 36 98 15 01 00 00 00 00 02 38 a0 15 01 00 00 00 00 02 3a c0 15 01 00 00 00 00 02 3d e0 15 01 00 00 00 00 02 40 f0 15 01 00 00 00 00 02 42 00 15 01 00 00 00 00 02 43 01 15 01 00 00 00 00 02 44 40 15 01 00 00 00 00 02 45 01 15 01 00 00 00 00 02 46 80 15 01 00 00 00 00 02 47 01 15 01 00 00 00 00 02 48 c0 15 01 00 00 00 00 02 49 01 15 01 00 00 00 00 02 4a 00 15 01 00 00 00 00 02 4b 02 15 01 00 00 00 00 02 4c 40 15 01 00 00 00 00 02 4d 02 15 01 00 00 00 00 02 4e 80 15 01 00 00 00 00 02 4f 02 15 01 00 00 00 00 02 50 00 15 01 00 00 00 00 02 51 03 15 01 00 00 00 00 02 52 80 15 01 00 00 00 00 02 53 03 15 01 00 00 00 00 02 54 00 15 01 00 00 00 00 02 55 04 15 01 00 00 00 00 02 56 8d 15 01 00 00 00 00 02 58 04 15 01 00 00 00 00 02 59 20 15 01 00 00 00 00 02 5a 05 15 01 00 00 00 00 02 5b bd 15 01 00 00 00 00 02 5c 05 15 01 00 00 00 00 02 5d 63 15 01 00 00 00 00 02 5e 06 15 01 00 00 00 00 02 5f 13 15 01 00 00 00 00 02 60 07 15 01 00 00 00 00 02 61 cd 15 01 00 00 00 00 02 62 07 15 01 00 00 00 00 02 63 91 15 01 00 00 00 00 02 64 08 15 01 00 00 00 00 02 65 60 15 01 00 00 00 00 02 66 09 15 01 00 00 00 00 02 67 38 15 01 00 00 00 00 02 68 0a 15 01 00 00 00 00 02 69 1a 15 01 00 00 00 00 02 6a 0b 15 01 00 00 00 00 02 6b 07 15 01 00 00 00 00 02 6c 0c 15 01 00 00 00 00 02 6d fe 15 01 00 00 00 00 02 6e 0c 15 01 00 00 00 00 02 6f 00 15 01 00 00 00 00 02 70 0e 15 01 00 00 00 00 02 71 0c 15 01 00 00 00 00 02 72 0f 15 01 00 00 00 00 02 73 96 15 01 00 00 00 00 02 74 0f 15 01 00 00 00 00 02 75 dc 15 01 00 00 00 00 02 76 0f 15 01 00 00 00 00 02 77 ff 15 01 00 00 00 00 02 78 0f 15 01 00 00 00 00 02 79 00 15 01 00 00 00 00 02 7a 00 15 01 00 00 00 00 02 7b 00 15 01 00 00 00 00 02 7c 01 15 01 00 00 00 00 02 7d 02 15 01 00 00 00 00 02 7e 04 15 01 00 00 00 00 02 7f 08 15 01 00 00 00 00 02 80 10 15 01 00 00 00 00 02 81 20 15 01 00 00 00 00 02 82 30 15 01 00 00 00 00 02 83 40 15 01 00 00 00 00 02 84 50 15 01 00 00 00 00 02 85 60 15 01 00 00 00 00 02 86 70 15 01 00 00 00 00 02 87 78 15 01 00 00 00 00 02 88 88 15 01 00 00 00 00 02 89 96 15 01 00 00 00 00 02 8a a3 15 01 00 00 00 00 02 8b af 15 01 00 00 00 00 02 8c ba 15 01 00 00 00 00 02 8d c4 15 01 00 00 00 00 02 8e ce 15 01 00 00 00 00 02 8f d7 15 01 00 00 00 00 02 90 e0 15 01 00 00 00 00 02 91 e8 15 01 00 00 00 00 02 92 f0 15 01 00 00 00 00 02 93 f8 15 01 00 00 00 00 02 94 ff 15 01 00 00 00 00 02 99 20 15 01 00 00 00 00 02 fe 00 15 01 00 00 00 00 02 c2 09 15 01 00 00 00 00 02 35 00 15 01 00 00 00 00 02 53 28 15 01 00 00 00 00 02 51 28 15 01 00 00 78 00 02 11 00 15 01 00 00 3a 00 02 29 00];
        qcom,mdss-dsi-on-command-state = "dsi_lp_mode";
        qcom,mdss-dsi-panel-framerate = <0x3c>;
        qcom,mdss-dsi-panel-height = <0x780>;
        qcom,mdss-dsi-panel-name = "guoxian rm67198 amoled 1080p cmd mode dsi panel";
        qcom,mdss-dsi-panel-status-check-mode = "te_signal_check";
        qcom,mdss-dsi-panel-timings = <0xe7362400 0x666a2a3a 0x2d030400>;
        qcom,mdss-dsi-panel-timings-phy-v2 = <0x221e0708 0x40304a0 0x221e0708 0x40304a0 0x221e0708 0x40304a0 0x221e0708 0x40304a0 0x22180708 0x40304a0>;
        qcom,mdss-dsi-panel-type = "dsi_cmd_mode";
        qcom,mdss-dsi-panel-width = <0x438>;
        qcom,mdss-dsi-reset-sequence = <0x1 0xa 0x0 0x14 0x1 0xa>;
        qcom,mdss-dsi-stream = <0x0>;
        qcom,mdss-dsi-t-clk-post = <0xd>;
        qcom,mdss-dsi-t-clk-pre = <0x2e>;
        qcom,mdss-dsi-te-check-enable;
        qcom,mdss-dsi-te-dcs-command = <0x1>;
        qcom,mdss-dsi-te-pin-select = <0x1>;
        qcom,mdss-dsi-te-using-te-pin;
        qcom,mdss-dsi-traffic-mode = "burst_mode";
        qcom,mdss-dsi-underflow-color = <0xff>;
        qcom,mdss-dsi-v-back-porch = <0x4>;
        qcom,mdss-dsi-v-bottom-border = <0x0>;
        qcom,mdss-dsi-v-front-porch = <0x8>;
        qcom,mdss-dsi-v-pulse-width = <0x4>;
        qcom,mdss-dsi-v-top-border = <0x0>;
        qcom,mdss-dsi-virtual-channel-id = <0x0>;
        qcom,mdss-dsi-wr-mem-continue = <0x3c>;
        qcom,mdss-dsi-wr-mem-start = <0x2c>;
        qcom,mdss-pan-physical-height-dimension = <0x79>;
        qcom,mdss-pan-physical-width-dimension = <0x44>;
    };
};