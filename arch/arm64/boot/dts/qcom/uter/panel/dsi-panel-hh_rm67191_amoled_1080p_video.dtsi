&mdss_mdp {
    dsi_hh_rm67191_amoled_1080p_video: qcom,mdss_dsi_hh_rm67191_amoled_1080p_video {
        qcom,cont-splash-enabled;
        qcom,esd-check-enabled;
        qcom,mdss-dsi-bl-min-level = <0x2>;
        qcom,mdss-dsi-bl-pmic-control-type = "bl_ctrl_dcs";
        qcom,mdss-dsi-bllp-eof-power-mode;
        qcom,mdss-dsi-bllp-power-mode;
        qcom,mdss-dsi-border-color = <0x0>;
        qcom,mdss-dsi-bpp = <0x18>;
        qcom,mdss-dsi-dma-trigger = "trigger_sw";
        qcom,mdss-dsi-h-back-porch = <0x24>;
        qcom,mdss-dsi-h-front-porch = <0x1a>;
        qcom,mdss-dsi-h-left-border = <0x0>;
        qcom,mdss-dsi-h-pulse-width = <0x2>;
        qcom,mdss-dsi-h-right-border = <0x0>;
        qcom,mdss-dsi-h-sync-pulse = <0x0>;
        qcom,mdss-dsi-h-sync-skew = <0x0>;
        qcom,mdss-dsi-lane-0-state;
        qcom,mdss-dsi-lane-1-state;
        qcom,mdss-dsi-lane-2-state;
        qcom,mdss-dsi-lane-3-state;
        qcom,mdss-dsi-mdp-trigger = "none";
        qcom,mdss-dsi-off-command = <0x5010000 0x10000128 0x5010000 0x40000110>;
        qcom,mdss-dsi-off-command-state = "dsi_hs_mode";
        qcom,mdss-dsi-on-command = [29 01 00 00 00 00 02 fe 0b 29 01 00 00 00 00 02 28 40 29 01 00 00 00 00 02 29 4f 29 01 00 00 00 00 02 fe 0e 29 01 00 00 00 00 02 4b 00 29 01 00 00 00 00 02 4c 0f 29 01 00 00 00 00 02 4d 20 29 01 00 00 00 00 02 4e 40 29 01 00 00 00 00 02 4f 60 29 01 00 00 00 00 02 50 a0 29 01 00 00 00 00 02 51 c0 29 01 00 00 00 00 02 52 e0 29 01 00 00 00 00 02 53 ff 29 01 00 00 00 00 02 fe 0d 29 01 00 00 00 00 02 18 08 29 01 00 00 00 00 02 42 00 29 01 00 00 00 00 02 08 41 29 01 00 00 00 00 02 46 02 29 01 00 00 00 00 02 72 09 29 01 00 00 00 00 02 fe 0a 29 01 00 00 00 00 02 24 17 29 01 00 00 00 00 02 04 07 29 01 00 00 00 00 02 1a 0c 29 01 00 00 00 00 02 0f 44 29 01 00 00 00 00 02 fe 04 29 01 00 00 00 00 02 00 0c 29 01 00 00 00 00 02 05 08 29 01 00 00 00 00 02 06 08 29 01 00 00 00 00 02 08 08 29 01 00 00 00 00 02 09 08 29 01 00 00 00 00 02 0a e6 29 01 00 00 00 00 02 0b 8c 29 01 00 00 00 00 02 1a 12 29 01 00 00 00 00 02 1e e0 29 01 00 00 00 00 02 29 93 29 01 00 00 00 00 02 2a 93 29 01 00 00 00 00 02 2f 02 29 01 00 00 00 00 02 31 02 29 01 00 00 00 00 02 33 05 29 01 00 00 00 00 02 37 2d 29 01 00 00 00 00 02 38 2d 29 01 00 00 00 00 02 3a 1e 29 01 00 00 00 00 02 3b 1e 29 01 00 00 00 00 02 3d 27 29 01 00 00 00 00 02 3f 80 29 01 00 00 00 00 02 40 40 29 01 00 00 00 00 02 41 e0 29 01 00 00 00 00 02 4f 2f 29 01 00 00 00 00 02 50 1e 29 01 00 00 00 00 02 fe 06 29 01 00 00 00 00 02 00 cc 29 01 00 00 00 00 02 05 05 29 01 00 00 00 00 02 07 a2 29 01 00 00 00 00 02 08 cc 29 01 00 00 00 00 02 0d 03 29 01 00 00 00 00 02 0f a2 29 01 00 00 00 00 02 32 cc 29 01 00 00 00 00 02 37 05 29 01 00 00 00 00 02 39 83 29 01 00 00 00 00 02 3a cc 29 01 00 00 00 00 02 41 04 29 01 00 00 00 00 02 43 83 29 01 00 00 00 00 02 44 cc 29 01 00 00 00 00 02 49 05 29 01 00 00 00 00 02 4b a2 29 01 00 00 00 00 02 4c cc 29 01 00 00 00 00 02 51 03 29 01 00 00 00 00 02 53 a2 29 01 00 00 00 00 02 75 cc 29 01 00 00 00 00 02 7a 03 29 01 00 00 00 00 02 7c 83 29 01 00 00 00 00 02 7d cc 29 01 00 00 00 00 02 82 02 29 01 00 00 00 00 02 84 83 29 01 00 00 00 00 02 85 ec 29 01 00 00 00 00 02 86 0f 29 01 00 00 00 00 02 87 ff 29 01 00 00 00 00 02 88 00 29 01 00 00 00 00 02 8a 02 29 01 00 00 00 00 02 8c a2 29 01 00 00 00 00 02 8d ea 29 01 00 00 00 00 02 8e 01 29 01 00 00 00 00 02 8f e8 29 01 00 00 00 00 02 fe 06 29 01 00 00 00 00 02 90 0a 29 01 00 00 00 00 02 92 06 29 01 00 00 00 00 02 93 a0 29 01 00 00 00 00 02 94 a8 29 01 00 00 00 00 02 95 ec 29 01 00 00 00 00 02 96 0f 29 01 00 00 00 00 02 97 ff 29 01 00 00 00 00 02 98 00 29 01 00 00 00 00 02 9a 02 29 01 00 00 00 00 02 9c a2 29 01 00 00 00 00 02 ac 04 29 01 00 00 00 00 02 fe 06 29 01 00 00 00 00 02 b1 12 29 01 00 00 00 00 02 b2 17 29 01 00 00 00 00 02 b3 17 29 01 00 00 00 00 02 b4 17 29 01 00 00 00 00 02 b5 17 29 01 00 00 00 00 02 b6 11 29 01 00 00 00 00 02 b7 08 29 01 00 00 00 00 02 b8 09 29 01 00 00 00 00 02 b9 06 29 01 00 00 00 00 02 ba 07 29 01 00 00 00 00 02 bb 17 29 01 00 00 00 00 02 bc 17 29 01 00 00 00 00 02 bd 17 29 01 00 00 00 00 02 be 17 29 01 00 00 00 00 02 bf 17 29 01 00 00 00 00 02 c0 17 29 01 00 00 00 00 02 c1 17 29 01 00 00 00 00 02 c2 17 29 01 00 00 00 00 02 c3 17 29 01 00 00 00 00 02 c4 0f 29 01 00 00 00 00 02 c5 0e 29 01 00 00 00 00 02 c6 00 29 01 00 00 00 00 02 c7 01 29 01 00 00 00 00 02 c8 10 29 01 00 00 00 00 02 fe 06 29 01 00 00 00 00 02 95 ec 29 01 00 00 00 00 02 8d ee 29 01 00 00 00 00 02 44 ec 29 01 00 00 00 00 02 4c ec 29 01 00 00 00 00 02 32 ec 29 01 00 00 00 00 02 3a ec 29 01 00 00 00 00 02 7d ec 29 01 00 00 00 00 02 75 ec 29 01 00 00 00 00 02 00 ec 29 01 00 00 00 00 02 08 ec 29 01 00 00 00 00 02 85 ec 29 01 00 00 00 00 02 a6 21 29 01 00 00 00 00 02 a7 05 29 01 00 00 00 00 02 a9 06 29 01 00 00 00 00 02 82 06 29 01 00 00 00 00 02 41 06 29 01 00 00 00 00 02 7a 07 29 01 00 00 00 00 02 37 07 29 01 00 00 00 00 02 05 06 29 01 00 00 00 00 02 49 06 29 01 00 00 00 00 02 0d 04 29 01 00 00 00 00 02 51 04 29 01 00 00 00 00 02 fe 00 29 01 00 00 00 00 02 c2 08 29 01 00 00 00 00 02 35 00 29 01 00 00 00 00 03 44 03 80 29 01 00 00 00 00 02 51 28 29 01 00 00 78 00 02 11 00 29 01 00 00 78 00 02 29 00];
        qcom,mdss-dsi-on-command-state = "dsi_lp_mode";
        qcom,mdss-dsi-panel-framerate = <0x3c>;
        qcom,mdss-dsi-panel-height = <0x780>;
        qcom,mdss-dsi-panel-name = "hehui rm67191 amoled 1080p cmd mode dsi panel";
        qcom,mdss-dsi-panel-status-check-mode = "te_signal_check";
        qcom,mdss-dsi-panel-timings = <0xe7362400 0x666a2a3a 0x2d030400>;
        qcom,mdss-dsi-panel-timings-phy-v2 = <0x221e0708 0x40304a0 0x221e0708 0x40304a0 0x221e0708 0x40304a0 0x221e0708 0x40304a0 0x24180708 0x40304a0>;
        qcom,mdss-dsi-panel-type = "dsi_cmd_mode";
        qcom,mdss-dsi-panel-width = <0x438>;
        qcom,mdss-dsi-reset-sequence = <0x1 0xa 0x0 0x14 0x1 0xa>;
        qcom,mdss-dsi-stream = <0x0>;
        qcom,mdss-dsi-t-clk-post = <0xd>;
        qcom,mdss-dsi-t-clk-pre = <0x2e>;
        qcom,mdss-dsi-te-check-enable;
        qcom,mdss-dsi-te-dcs-command = <0x1>;
        qcom,mdss-dsi-te-pin-select = <0x1>;
        qcom,mdss-dsi-te-using-te-pin;
        qcom,mdss-dsi-traffic-mode = "burst_mode";
        qcom,mdss-dsi-underflow-color = <0xff>;
        qcom,mdss-dsi-v-back-porch = <0x4>;
        qcom,mdss-dsi-v-bottom-border = <0x0>;
        qcom,mdss-dsi-v-front-porch = <0x8>;
        qcom,mdss-dsi-v-pulse-width = <0x4>;
        qcom,mdss-dsi-v-top-border = <0x0>;
        qcom,mdss-dsi-virtual-channel-id = <0x0>;
        qcom,mdss-dsi-wr-mem-continue = <0x3c>;
        qcom,mdss-dsi-wr-mem-start = <0x2c>;
        qcom,mdss-pan-physical-height-dimension = <0x79>;
        qcom,mdss-pan-physical-width-dimension = <0x44>;
    };
};