&mdss_mdp {
    dsi_sharp_ft8716_fhd_video: qcom,mdss_dsi_sharp_ft8716_fhd_video {
        qcom,mdss-dsi-bl-max-level = <0xfff>;
        qcom,mdss-dsi-bl-min-level = <0x1>;
        qcom,mdss-dsi-bl-pmic-control-type = "bl_ctrl_wled";
        qcom,mdss-dsi-bllp-eof-power-mode;
        qcom,mdss-dsi-bllp-power-mode;
        qcom,mdss-dsi-border-color = <0x0>;
        qcom,mdss-dsi-bpp = <0x18>;
        qcom,mdss-dsi-dma-trigger = "trigger_sw";
        qcom,mdss-dsi-h-back-porch = <0x20>;
        qcom,mdss-dsi-h-front-porch = <0x20>;
        qcom,mdss-dsi-h-left-border = <0x0>;
        qcom,mdss-dsi-h-pulse-width = <0x4>;
        qcom,mdss-dsi-h-right-border = <0x0>;
        qcom,mdss-dsi-h-sync-pulse = <0x0>;
        qcom,mdss-dsi-h-sync-skew = <0x0>;
        qcom,mdss-dsi-lane-0-state;
        qcom,mdss-dsi-lane-1-state;
        qcom,mdss-dsi-lane-2-state;
        qcom,mdss-dsi-lane-3-state;
        qcom,mdss-dsi-max-refresh-rate = <0x3c>;
        qcom,mdss-dsi-mdp-trigger = "none";
        qcom,mdss-dsi-min-refresh-rate = <0x30>;
        qcom,mdss-dsi-off-command = <0x5010000 0x4b000128 0x5010000 0xe000110>;
        qcom,mdss-dsi-off-command-state = "dsi_lp_mode";
        qcom,mdss-dsi-on-command = [05 01 00 00 78 00 01 11 15 01 00 00 00 00 02 51 ff 15 01 00 00 01 00 02 53 24 05 01 00 00 05 00 01 29];
        qcom,mdss-dsi-on-command-state = "dsi_lp_mode";
        qcom,mdss-dsi-panel-controller = <&mdss_dsi0>;
        qcom,mdss-dsi-panel-framerate = <0x3c>;
        qcom,mdss-dsi-panel-height = <0x780>;
        qcom,mdss-dsi-panel-name = "sharp 1080p video mode dsi panel";
        qcom,mdss-dsi-panel-orientation = "180";
        qcom,mdss-dsi-panel-status-check-mode = "bta_check";
        qcom,mdss-dsi-panel-timings = <0xe7362400 0x666a2a3a 0x2d030400>;
        qcom,mdss-dsi-panel-timings-phy-v2 = <0x231e0809 0x50304a0 0x231e0809 0x50304a0 0x231e0809 0x50304a0 0x231e0809 0x50304a0 0x231a0809 0x50304a0>;
        qcom,mdss-dsi-panel-type = "dsi_video_mode";
        qcom,mdss-dsi-panel-width = <0x438>;
        qcom,mdss-dsi-post-init-delay = <0x1>;
        qcom,mdss-dsi-reset-sequence = <0x1 0xa 0x0 0xa 0x1 0xa>;
        qcom,mdss-dsi-stream = <0x0>;
        qcom,mdss-dsi-t-clk-post = <0xd>;
        qcom,mdss-dsi-t-clk-pre = <0x2d>;
        qcom,mdss-dsi-te-check-enable;
        qcom,mdss-dsi-te-using-te-pin;
        qcom,mdss-dsi-traffic-mode = "burst_mode";
        qcom,mdss-dsi-underflow-color = <0xff>;
        qcom,mdss-dsi-v-back-porch = <0x10>;
        qcom,mdss-dsi-v-bottom-border = <0x0>;
        qcom,mdss-dsi-v-front-porch = <0x10>;
        qcom,mdss-dsi-v-pulse-width = <0x2>;
        qcom,mdss-dsi-v-top-border = <0x0>;
        qcom,mdss-dsi-virtual-channel-id = <0x0>;
    };
};