#include "pinctrl.dtsi"

#include "battery.dtsi"
#include "camera.dtsi"
#include "display.dtsi"
#include "fingerprint.dtsi"
#include "ir.dtsi"
#include "misc.dtsi"
#include "power.dtsi"
#include "soc.dtsi"
#include "touchscreen.dtsi"

#include "android.dtsi"
#include "ramoops.dtsi"
