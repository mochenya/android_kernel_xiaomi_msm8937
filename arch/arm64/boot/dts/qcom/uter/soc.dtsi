/* msm8953.dtsi */
&other_ext_mem {
	reg = <0x0 0x83300000 0x0 0x3800000>;
};
&adsp_fw_mem {
	reg = <0x0 0x8d600000 0x0 0x1200000>;
};
&wcnss_fw_mem {
	reg = <0x0 0x8e800000 0x0 0x700000>;
};
&qcom_seecom {
	reg = <0x83300000 0x3000000>;
};